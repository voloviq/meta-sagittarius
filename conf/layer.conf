## conf/layer.conf
```bitbake
# We have a conf and classes directory, add to BBPATH
BBPATH .= ":${LAYERDIR}"

# We have a recipes-* directories, add to BBFILES
BBFILES += "${LAYERDIR}/recipes-*/*/*.bb \
	${LAYERDIR}/recipes-*/*/*.bbappend"

BBFILE_COLLECTIONS += "meta-sagittarius"
BBFILE_PATTERN_meta-sagittarius = "^${LAYERDIR}/"
BBFILE_PRIORITY_meta-sagittarius = "7"

EULA_FILE_ST:stm32mpsagittarius = "${LAYERDIR}/conf/eula/${MACHINE}"
EULA_FILE_ST_MD5SUM:stm32mpsagittarius = "8b505090fb679839cefbcc784afe8ce9"

#Inform bitbake for adding another location to search for licenses
LICENSE_PATH += "${LAYERDIR}/files/licenses"

# This should only be incremented on significant changes that will
# cause compatibility issues with other layers
LAYERSERIES_COMPAT_meta-sagittarius = "kirkstone"

# for optee-os-stm32mp dependency
LAYERDEPENDS_meta-sagittarius = "core openembedded-layer meta-python stm-st-stm32mp-mx"

# OpenSTLinux compatibility version
ST_OSTL_COMPATIBILITY_VERSION_meta-sagittarius = "4.1.0"

# Set a variable to get the STM32MP MX BSP location
STM32MP_SAGITTARIUS = "${LAYERDIR}"

# This should only be incremented on significant changes that may
# cause compatibility issues with other layers
LAYERVERSION_meta-sagittarius = "1"
```
